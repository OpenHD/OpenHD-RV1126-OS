## buildroot/configs/rockchip_rv1126_rv1109_defconfig
```kconfig
#include "base/base.config"
#include "chips/rv1126_rv1109_arm.config"
#include "multimedia/audio.config"
#include "multimedia/camera.config"
#include "multimedia/mpp.config"
#include "multimedia/gst/video.config"
#include "multimedia/gst/camera.config"
#include "multimedia/gst/rtsp.config"
#include "multimedia/gst/audio.config"
#include "debug.config"
#include "update_engine.config"
BR2_PACKAGE_CAMERA_ENGINE_RKAIQ_IQFILE="os04a10_CMK-OT1607-FV1_M12-40IRC-4MP-F16.xml imx335_MTV4-IR-E-P_40IRC-4MP-F16.xml imx415_YT10092_IR0147-36IRC-8M-F20.xml"
BR2_PACKAGE_CAMERA_ENGINE_RKAIQ_RKISP_DEMO=y
BR2_PACKAGE_COMMON_ALGORITHM_AEC_ANR_AGC=y
BR2_PACKAGE_COMMON_ALGORITHM_ANR=y
BR2_PACKAGE_DBUS_CPP=y
BR2_PACKAGE_DBUS_GLIB=y
# BR2_PACKAGE_DRM_DISPLAY_OUTPUT is not set
# BR2_PACKAGE_EUDEV_ENABLE_HWDB is not set
BR2_PACKAGE_FCGIWRAP=y
# BR2_PACKAGE_IPCWEB_BACKEND is not set
# BR2_PACKAGE_IPCWEB_BACKEND_USE_RKIPC is not set
BR2_PACKAGE_JSON_C=y
# BR2_PACKAGE_NGINX is not set
# BR2_PACKAGE_NGINX_DEBUG is not set
# BR2_PACKAGE_NGINX_HTTP_FLV_LIVE is not set
# BR2_PACKAGE_NGINX_HTTP_FLV_MODULE is not set
# BR2_PACKAGE_NGINX_HTTP_SSL_MODULE is not set
# BR2_PACKAGE_NTP_NTPD is not set
BR2_PACKAGE_NETWORK_MANAGER=y
BR2_PACKAGE_OPENHD=y
BR2_PACKAGE_RSYNC=y
BR2_PACKAGE_OEM=y
BR2_PACKAGE_PIXMAN=y
BR2_PACKAGE_RKFSMK=y
# BR2_PACKAGE_RKIPC is not set
# BR2_PACKAGE_RKIPC_RV1126 is not set
BR2_PACKAGE_RKMEDIA_ALSA=y
BR2_PACKAGE_RKMEDIA_ALSA_CAPTURE=y
BR2_PACKAGE_RKMEDIA_ALSA_PLAYBACK=y
BR2_PACKAGE_RKMEDIA_AUDIO_ALGORITHM=y
BR2_PACKAGE_RKMEDIA_AUDIO_CODEC=y
BR2_PACKAGE_RKMEDIA_AUDIO_DECODER=y
BR2_PACKAGE_RKMEDIA_AUDIO_ENCODER=y
# BR2_PACKAGE_RKMEDIA_EXAMPLES is not set
# BR2_PACKAGE_RKMEDIA_MOVE_DETECTION is not set
BR2_PACKAGE_RKMEDIA_MPP=y
# BR2_PACKAGE_RKMEDIA_OCCLUSION_DETECTION is not set
BR2_PACKAGE_RKMEDIA_RKNN=y
BR2_PACKAGE_RKMEDIA_RKRGA=y
BR2_PACKAGE_RKMEDIA_USE_AIQ=y
BR2_PACKAGE_RKMEDIA_V4L2_CAPTURE=y
BR2_PACKAGE_GSTREAMER1_CHECK=y
BR2_PACKAGE_GSTREAMER1_PARSE=y
BR2_PACKAGE_GSTREAMER1_TRACE=y
BR2_PACKAGE_GSTREAMER1_GST_DEBUG=y
BR2_PACKAGE_GSTREAMER1_PLUGIN_REGISTRY=y
BR2_PACKAGE_GSTREAMER1_INSTALL_TOOLS=y
BR2_PACKAGE_GST1_PLUGINS_BASE=y
BR2_PACKAGE_GST1_PLUGINS_GOOD=y
BR2_PACKAGE_GST1_PLUGINS_BAD=y
BR2_PACKAGE_GST1_PLUGINS_UGLY=y
BR2_PACKAGE_GSTREAMER1_ROCKCHIP=y
BR2_PACKAGE_POCO=y

#
# poco components
#
# BR2_PACKAGE_POCO_ACTIVERECORD is not set
# BR2_PACKAGE_POCO_CPP_PARSER is not set
# BR2_PACKAGE_POCO_CRYPTO is not set
# BR2_PACKAGE_POCO_DATA_MYSQL is not set
# BR2_PACKAGE_POCO_DATA_PGSQL is not set
# BR2_PACKAGE_POCO_DATA_SQLITE is not set
# BR2_PACKAGE_POCO_JSON is not set
# BR2_PACKAGE_POCO_JWT is not set
# BR2_PACKAGE_POCO_MONGODB is not set
BR2_PACKAGE_POCO_NET=y
# BR2_PACKAGE_POCO_NETSSL_OPENSSL is not set
# BR2_PACKAGE_POCO_PDF is not set
# BR2_PACKAGE_POCO_REDIS is not set
# BR2_PACKAGE_POCO_UTIL is not set
# BR2_PACKAGE_POCO_XML is not set
# BR2_PACKAGE_POCO_ZIP is not set
BR2_PACKAGE_PYTHON3=y
BR2_PACKAGE_PYTHON_PIP=y
# BR2_PACKAGE_ROCKX_PERSON_DETECTION is not set
BR2_PACKAGE_SQLITE=y
BR2_PACKAGE_SYSSTAT=y
BR2_PACKAGE_RKSCRIPT_USB_MTP=y
BR2_PACKAGE_VENDOR_STORAGE_LIBRARY=y
BR2_ROOTFS_OVERLAY+="board/rockchip/rv1126_rv1109/fs-overlay-sysv/"
BR2_TARGET_GENERIC_HOSTNAME="OpenHD"
```

## buildroot/package/openhd-partition/Config.in
```kconfig
config BR2_PACKAGE_OPENHD_PARTITION
    bool "openhd_partition autostart script"
    help
      Automatically executes /oem/openhd_part.sh at boot.
```

## u-boot/fit/u-boot.its
```
/*
 * Copyright (C) 2020 Rockchip Electronic Co.,Ltd
 *
 * Simple U-boot fit source file containing ATF/OP-TEE/U-Boot/dtb/MCU
 */

/dts-v1/;

/ {
	description = "FIT Image with ATF/OP-TEE/U-Boot/MCU";
	#address-cells = <1>;

	images {

		uboot {
			description = "U-Boot";
			data = /incbin/("u-boot-nodtb.bin.gz");
			type = "standalone";
			arch = "arm";
			os = "U-Boot";
			compression = "gzip";
			load = <0x00600000>;
			digest {
				value = /incbin/("./u-boot-nodtb.bin.digest");
				algo = "sha256";
			};
			hash {
				algo = "sha256";
			};
		};
		optee {
			description = "OP-TEE";
			data = /incbin/("tee.bin.gz");
			type = "firmware";
			arch = "arm";
			os = "op-tee";
			compression = "gzip";
			entry = <0x8400000>;
			load = <0x8400000>;
			digest {
				value = /incbin/("./tee.bin.digest");
				algo = "sha256";
			};
			hash {
				algo = "sha256";
			};
		};
		fdt {
			description = "U-Boot dtb";
			data = /incbin/("./u-boot.dtb");
			type = "flat_dt";
			arch = "arm";
			compression = "none";
			hash {
				algo = "sha256";
			};
		};
	};

	configurations {
		default = "conf";
		conf {
			description = "rv1126-evb";
			rollback-index = <0x0>;
			firmware = "optee";
			loadables = "uboot";
			
			fdt = "fdt";
			signature {
				algo = "sha256,rsa2048";
				
				key-name-hint = "dev";
				sign-images = "fdt", "loadables", "firmware";
			};
		};
	};
};
```
